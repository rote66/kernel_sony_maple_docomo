## drivers/char/frandom/Kconfig
```kconfig
config FRANDOM
	tristate "frandom support"
	default y
	---help---
	   Say Y to compile frandom as module.
	   The module will be called frandom.ko.
```

## drivers/input/misc/bu520x1nvx/Kconfig
```kconfig
config INPUT_BU520X1NVX
	tristate "BU520X1NVX driver support"
	default n
	help
	  Say Y here
	  if you want to
	  support BU520X1NVX
	  as bipolar detection device.
```

## drivers/input/misc/fpc1145/Kconfig
```kconfig
 config FPC1145_PLATFORM
       tristate "Platform FPC1145 fingerprint driver"
       default n
       help
         Select this module to enable FPC1145 fingerprint driver
```

## drivers/misc/carillon/Kconfig
```kconfig
comment "Sony Carillon NFC driver"

config CARILLON_NFC
	tristate "Sony Carillon protocol driver (I2C) devices"
	default n
```

## drivers/misc/ldo_vibrator/Kconfig
```kconfig
config LDO_VIBRATOR
	tristate "LDO Vibrator"
	default n
	help
	  This option enables device driver support for the vibrator
	  on the LDO line. The vibrator is controlled using the
	  timed output class.
```

## drivers/misc/sim_detect/Kconfig
```kconfig
config SIM_DETECT
	tristate "SIM_DETECT driver support"
	default n
	help
	  Say Y here
	  if you want to support SIM_DETECT as detection device.
	  This driver can be used for sending notifications via
	  switch_class when sim card is inserted or removed.
```
